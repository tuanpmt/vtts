## firmware/esp32/main/Kconfig.projbuild
```kconfig
menu "vtts board"

choice VTTS_BOARD
    prompt "Target board"
    default VTTS_BOARD_S3_TOUCH_LCD_28 if IDF_TARGET_ESP32S3
    default VTTS_BOARD_P4_86_PANEL
    help
        Board whose speaker path (ES8311 codec or PCM5101 DAC) is used for playback.

config VTTS_BOARD_P4_86_PANEL
    bool "Waveshare ESP32-P4-86-Panel"
    depends on IDF_TARGET_ESP32P4
config VTTS_BOARD_P4_NANO
    bool "Waveshare ESP32-P4-NANO"
    depends on IDF_TARGET_ESP32P4
config VTTS_BOARD_S3_TOUCH_LCD_28
    bool "Waveshare ESP32-S3-Touch-LCD-2.8"
    depends on IDF_TARGET_ESP32S3
config VTTS_BOARD_S3_ECHOEAR
    bool "EchoEar 2.0 (ESP32-S3-WROOM-1, 16 MB flash, 8 MB octal PSRAM)"
    depends on IDF_TARGET_ESP32S3
endchoice

endmenu
```

## firmware/esp32p4/main/Kconfig.projbuild
```kconfig
menu "vtts board"

choice VTTS_BOARD
    prompt "Target board"
    default VTTS_BOARD_S3_TOUCH_LCD_28 if IDF_TARGET_ESP32S3
    default VTTS_BOARD_P4_86_PANEL
    help
        Board whose speaker path (ES8311 codec or PCM5101 DAC) is used for playback.

config VTTS_BOARD_P4_86_PANEL
    bool "Waveshare ESP32-P4-86-Panel"
    depends on IDF_TARGET_ESP32P4
config VTTS_BOARD_P4_NANO
    bool "Waveshare ESP32-P4-NANO"
    depends on IDF_TARGET_ESP32P4
config VTTS_BOARD_S3_TOUCH_LCD_28
    bool "Waveshare ESP32-S3-Touch-LCD-2.8"
    depends on IDF_TARGET_ESP32S3
endchoice

endmenu
```
